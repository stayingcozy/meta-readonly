## conf/layer.conf
```bitbake
BBPATH .= ":${LAYERDIR}"

BBFILES += "${LAYERDIR}/recipes-*/*/*.bb \
            ${LAYERDIR}/recipes-*/*/*.bbappend"

BBFILE_COLLECTIONS += "readonly"
BBFILE_PATTERN_readonly = "^${LAYERDIR}/"
BBFILE_PRIORITY_readonly = "10"

LAYERDEPENDS_readonly = "core"
LAYERSERIES_COMPAT_readonly = "scarthgap"
```
